## Documentation/devicetree/bindings/display/panel/xiaomi,k3s-42-02-0a.yaml
```yaml
# SPDX-License-Identifier: (GPL-2.0-only OR BSD-2-Clause)
%YAML 1.2
---
$id: http://devicetree.org/schemas/display/panel/xiaomi,k3s-42-02-0a.yaml#
$schema: http://devicetree.org/meta-schemas/core.yaml#

title: Xiaomi k3s 42 02 0a DSC AMOLED DSI panel

maintainers:
  - Shubham Vishwakarma <shubhamvis98@fossfrog.in>

description:
  1080x2400 AMOLED command mode panel with a Novatek DDIC, driven over a
  4-lane MIPI DSI link with Display Stream Compression (one 1080px slice
  per line, 8bpp, 10bpc). Used in the Xiaomi Mi 11T Pro (vili).

allOf:
  - $ref: panel-common.yaml#

properties:
  compatible:
    const: xiaomi,k3s-42-02-0a

  reg:
    maxItems: 1
    description: DSI virtual channel

  vddio-supply:
    description: 1.8V I/O supply

  dvdd-supply:
    description: Digital core supply

  vdd-supply:
    description: 3.0V panel supply

  avdd-supply:
    description: Analog AMOLED supply

  reset-gpios: true
  port: true

additionalProperties: false

required:
  - compatible
  - reg
  - vddio-supply
  - dvdd-supply
  - vdd-supply
  - avdd-supply
  - reset-gpios
  - port

examples:
  - |
    #include <dt-bindings/gpio/gpio.h>

    dsi {
        #address-cells = <1>;
        #size-cells = <0>;

        panel@0 {
            compatible = "xiaomi,k3s-42-02-0a";
            reg = <0>;

            reset-gpios = <&tlmm 24 GPIO_ACTIVE_LOW>;

            vddio-supply = <&vreg_l12c_1p8>;
            dvdd-supply = <&vreg_l1b_0p88>;
            vdd-supply = <&vreg_l13c_3p0>;
            avdd-supply = <&panel_avdd>;

            port {
                panel_in: endpoint {
                    remote-endpoint = <&dsi0_out>;
                };
            };
        };
    };
...
```

## Documentation/devicetree/bindings/media/i2c/dongwoon,dw9719.yaml
```yaml
# SPDX-License-Identifier: (GPL-2.0-only OR BSD-2-Clause)
%YAML 1.2
---
$id: http://devicetree.org/schemas/media/i2c/dongwoon,dw9719.yaml#
$schema: http://devicetree.org/meta-schemas/core.yaml#

title: Dongwoon Anatech DW9719 family Voice Coil Motor (VCM) Lens

maintainers:
  - Shubham Vishwakarma <shubhamvis98@fossfrog.in>

description:
  The Dongwoon DW9719, DW9761 and DW9800V are 10-bit digital-to-analog
  converters with a current sink output for driving voice coil lens actuators
  in camera modules. They are controlled over an I2C bus and support Smart
  Actuator Control (SAC) ringing compensation.

properties:
  compatible:
    enum:
      - dongwoon,dw9719
      - dongwoon,dw9761
      - dongwoon,dw9800v

  reg:
    maxItems: 1

  vdd-supply:
    description: Driver core and VCM output supply.

  vio-supply:
    description: I2C I/O supply.

  dongwoon,sac-mode:
    description:
      Smart Actuator Control mode, written to the mode register. The default
      depends on the chip model.
    $ref: /schemas/types.yaml#/definitions/uint32
    maximum: 15

  dongwoon,vcm-freq:
    description:
      VCM resonance frequency setting, written to the VCM frequency register.
      The default depends on the chip model.
    $ref: /schemas/types.yaml#/definitions/uint32
    maximum: 255

required:
  - compatible
  - reg
  - vdd-supply

additionalProperties: false

examples:
  - |
    i2c {
        #address-cells = <1>;
        #size-cells = <0>;

        camera-lens@c {
            compatible = "dongwoon,dw9800v";
            reg = <0x0c>;

            vdd-supply = <&vreg_cam_af>;
            vio-supply = <&vreg_cam_io>;
        };
    };

...
```

## Documentation/devicetree/bindings/media/i2c/ovti,ov16a1q.yaml
```yaml
# SPDX-License-Identifier: (GPL-2.0-only OR BSD-2-Clause)
%YAML 1.2
---
$id: http://devicetree.org/schemas/media/i2c/ovti,ov16a1q.yaml#
$schema: http://devicetree.org/meta-schemas/core.yaml#

title: OmniVision OV16A1Q Image Sensor

maintainers:
  - Shubham Vishwakarma <shubhamvis98@fossfrog.in>

description:
  The OmniVision OV16A1Q is a 16 MP CMOS image sensor with an active array
  of 4608 x 3456 pixels. It is controlled through an I2C compatible interface
  and sends image data over a 4-lane MIPI CSI-2 D-PHY link.

allOf:
  - $ref: /schemas/media/video-interface-devices.yaml#

properties:
  compatible:
    const: ovti,ov16a1q

  reg:
    maxItems: 1

  clocks:
    description: MCLK input clock (19.2 MHz).
    maxItems: 1

  power-domains:
    maxItems: 1

  reset-gpios:
    description: Active low reset GPIO.
    maxItems: 1

  vdig-supply:
    description: Digital core supply (1.2 V).

  vana-supply:
    description: Analog supply (2.8 V).

  vio-supply:
    description: I/O supply (1.8 V).

  port:
    $ref: /schemas/graph.yaml#/$defs/port-base
    additionalProperties: false

    properties:
      endpoint:
        $ref: /schemas/media/video-interfaces.yaml#
        unevaluatedProperties: false

        properties:
          data-lanes:
            items:
              - const: 1
              - const: 2
              - const: 3
              - const: 4

          link-frequencies: true

        required:
          - data-lanes
          - link-frequencies

    required:
      - endpoint

required:
  - compatible
  - reg
  - clocks
  - reset-gpios
  - vdig-supply
  - vana-supply
  - vio-supply
  - port

unevaluatedProperties: false

examples:
  - |
    #include <dt-bindings/gpio/gpio.h>

    i2c {
        #address-cells = <1>;
        #size-cells = <0>;

        camera@10 {
            compatible = "ovti,ov16a1q";
            reg = <0x10>;

            clocks = <&cam_mclk0>;
            assigned-clocks = <&cam_mclk0>;
            assigned-clock-rates = <19200000>;

            reset-gpios = <&tlmm 17 GPIO_ACTIVE_LOW>;

            vdig-supply = <&vreg_cam_dig>;
            vana-supply = <&vreg_cam_ana>;
            vio-supply = <&vreg_cam_io>;

            orientation = <0>;
            rotation = <90>;

            port {
                endpoint {
                    data-lanes = <1 2 3 4>;
                    link-frequencies = /bits/ 64 <384000000>;
                    remote-endpoint = <&csiphy3_ep>;
                };
            };
        };
    };
...
```

## Documentation/devicetree/bindings/media/i2c/samsung,s5k5e9.yaml
```yaml
# SPDX-License-Identifier: (GPL-2.0-only OR BSD-2-Clause)
%YAML 1.2
---
$id: http://devicetree.org/schemas/media/i2c/samsung,s5k5e9.yaml#
$schema: http://devicetree.org/meta-schemas/core.yaml#

title: Samsung S5K5E9 Image Sensor

maintainers:
  - Shubham Vishwakarma <shubhamvis98@fossfrog.in>

description:
  The Samsung S5K5E9 is a 5 MP CMOS image sensor with an active array of
  2592 x 1944 pixels. It is controlled through an I2C compatible interface
  and sends image data over a 2-lane MIPI CSI-2 D-PHY link.

allOf:
  - $ref: /schemas/media/video-interface-devices.yaml#

properties:
  compatible:
    const: samsung,s5k5e9

  reg:
    maxItems: 1

  clocks:
    description: MCLK input clock (19.2 MHz).
    maxItems: 1

  power-domains:
    maxItems: 1

  reset-gpios:
    description: Active low reset GPIO.
    maxItems: 1

  vdig-supply:
    description: Digital core supply (1.2 V).

  vana-supply:
    description: Analog supply (2.8 V).

  vio-supply:
    description: I/O supply (1.8 V).

  port:
    $ref: /schemas/graph.yaml#/$defs/port-base
    additionalProperties: false

    properties:
      endpoint:
        $ref: /schemas/media/video-interfaces.yaml#
        unevaluatedProperties: false

        properties:
          data-lanes:
            items:
              - const: 1
              - const: 2

          link-frequencies: true

        required:
          - data-lanes
          - link-frequencies

    required:
      - endpoint

required:
  - compatible
  - reg
  - clocks
  - reset-gpios
  - vdig-supply
  - vana-supply
  - vio-supply
  - port

unevaluatedProperties: false

examples:
  - |
    #include <dt-bindings/gpio/gpio.h>

    i2c {
        #address-cells = <1>;
        #size-cells = <0>;

        camera@2d {
            compatible = "samsung,s5k5e9";
            reg = <0x2d>;

            clocks = <&cam_mclk2>;
            assigned-clocks = <&cam_mclk2>;
            assigned-clock-rates = <19200000>;

            reset-gpios = <&tlmm 106 GPIO_ACTIVE_LOW>;

            vdig-supply = <&vreg_cam_dig>;
            vana-supply = <&vreg_cam_ana>;
            vio-supply = <&vreg_cam_io>;

            orientation = <1>;
            rotation = <270>;
            lens-focus = <&vcm>;

            port {
                endpoint {
                    data-lanes = <1 2>;
                    link-frequencies = /bits/ 64 <438400000>;
                    remote-endpoint = <&csiphy0_ep>;
                };
            };
        };
    };
...
```

## Documentation/devicetree/bindings/media/i2c/samsung,s5khm2.yaml
```yaml
# SPDX-License-Identifier: (GPL-2.0-only OR BSD-2-Clause)
%YAML 1.2
---
$id: http://devicetree.org/schemas/media/i2c/samsung,s5khm2.yaml#
$schema: http://devicetree.org/meta-schemas/core.yaml#

title: Samsung S5KHM2 Image Sensor

maintainers:
  - Shubham Vishwakarma <shubhamvis98@fossfrog.in>

description:
  The Samsung ISOCELL HM2 (S5KHM2) is a 108 MP CMOS image sensor with an
  active array of 12000 x 9000 pixels. It is controlled through an I2C
  compatible interface and sends image data over a 3-trio MIPI C-PHY link.

allOf:
  - $ref: /schemas/media/video-interface-devices.yaml#

properties:
  compatible:
    const: samsung,s5khm2

  reg:
    maxItems: 1

  clocks:
    description: MCLK input clock (19.2 MHz).
    maxItems: 1

  power-domains:
    maxItems: 1

  reset-gpios:
    description: Active low reset GPIO.
    maxItems: 1

  vdig-supply:
    description: Digital core supply (1.05 V).

  vana-supply:
    description: Analog supply (2.8 V).

  vio-supply:
    description: I/O supply (1.8 V).

  port:
    $ref: /schemas/graph.yaml#/$defs/port-base
    additionalProperties: false

    properties:
      endpoint:
        $ref: /schemas/media/video-interfaces.yaml#
        unevaluatedProperties: false

        properties:
          bus-type:
            const: 1 # MEDIA_BUS_TYPE_CSI2_CPHY

          data-lanes:
            items:
              - const: 1
              - const: 2
              - const: 3

          link-frequencies: true

        required:
          - bus-type
          - data-lanes
          - link-frequencies

    required:
      - endpoint

required:
  - compatible
  - reg
  - clocks
  - reset-gpios
  - vdig-supply
  - vana-supply
  - vio-supply
  - port

unevaluatedProperties: false

examples:
  - |
    #include <dt-bindings/gpio/gpio.h>
    #include <dt-bindings/media/video-interfaces.h>

    i2c {
        #address-cells = <1>;
        #size-cells = <0>;

        camera@10 {
            compatible = "samsung,s5khm2";
            reg = <0x10>;

            clocks = <&cam_mclk1>;
            assigned-clocks = <&cam_mclk1>;
            assigned-clock-rates = <19200000>;

            reset-gpios = <&tlmm 16 GPIO_ACTIVE_LOW>;

            vdig-supply = <&vreg_cam_dig>;
            vana-supply = <&vreg_cam_ana>;
            vio-supply = <&vreg_cam_io>;

            orientation = <1>;
            rotation = <270>;
            lens-focus = <&vcm>;

            port {
                endpoint {
                    bus-type = <MEDIA_BUS_TYPE_CSI2_CPHY>;
                    data-lanes = <1 2 3>;
                    link-frequencies = /bits/ 64 <899200000>;
                    remote-endpoint = <&csiphy2_ep>;
                };
            };
        };
    };
...
```

## drivers/input/touchscreen/fts_spi/Kconfig
```kconfig
config TOUCHSCREEN_ST_FTS_V521_SPI
	tristate "ST FTS V521 SPI Touchscreen"
	depends on SPI
	help
	  Say Y here if you have ST FTS series I2C touchscreen.

	  If unsure, say N.

	  To compile this driver as a module, choose M here: the
```
